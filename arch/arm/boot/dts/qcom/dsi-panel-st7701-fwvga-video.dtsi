/**********uniscope-driver-modify-file-on-qualcomm-platform*****************/
/* Copyright (c) 2013, The Linux Foundation. All rights reserved.
 *
 * This program is free software; you can redistribute it and/or modify
 * it under the terms of the GNU General Public License version 2 and
 * only version 2 as published by the Free Software Foundation.
 *
 * This program is distributed in the hope that it will be useful,
 * but WITHOUT ANY WARRANTY; without even the implied warranty of
 * MERCHANTABILITY or FITNESS FOR A PARTICULAR PURPOSE.  See the
 * GNU General Public License for more details.
 */

&mdss_mdp {
	dsi_st7701_fwvga_video: qcom,mdss_dsi_st7701_fwvga_video {
		qcom,mdss-dsi-panel-name = "st7701 fwvga video mode dsi panel";
		qcom,mdss-dsi-panel-controller = <&mdss_dsi0>;
		qcom,mdss-dsi-panel-type = "dsi_video_mode";
		qcom,mdss-dsi-panel-destination = "display_1";
		qcom,mdss-dsi-panel-framerate = <60>;
		qcom,mdss-dsi-virtual-channel-id = <0>;
		qcom,mdss-dsi-stream = <0>;
		qcom,mdss-dsi-panel-width = <480>;
		qcom,mdss-dsi-panel-height = <854>;
		qcom,mdss-dsi-h-front-porch = <60>;
		qcom,mdss-dsi-h-back-porch = <60>;
		qcom,mdss-dsi-h-pulse-width = <20>;
		qcom,mdss-dsi-h-sync-skew = <0>;
		qcom,mdss-dsi-v-back-porch = <10>;
		qcom,mdss-dsi-v-front-porch = <16>;
		qcom,mdss-dsi-v-pulse-width = <4>;
		qcom,mdss-dsi-h-left-border = <0>;
		qcom,mdss-dsi-h-right-border = <0>;
		qcom,mdss-dsi-v-top-border = <0>;
		qcom,mdss-dsi-v-bottom-border = <0>;
		qcom,mdss-dsi-bpp = <24>;
		qcom,mdss-dsi-color-order = "rgb_swap_rgb";
		qcom,mdss-dsi-underflow-color = <0xff>;
		qcom,mdss-dsi-border-color = <0>;
		qcom,mdss-dsi-on-command = [29 01 00 00 00 00 06 ff 77 01 00 00 10
			29 01 00 00 00 00 03 C0 E9 03
			29 01 00 00 00 00 03 C1 0A 02
			29 01 00 00 00 00 03 C2 31 08
			29 01 00 00 00 00 11 B0 00 09 99 15 1A 0B 12 09 09 22 01 0A 04 19 1E 19
			29 01 00 00 00 00 11 B1 00 09 98 13 17 0B 13 08 09 2A 0E 1F 1F 19 1D 19
			29 01 00 00 00 00 06 ff 77 01 00 00 11
			29 01 00 00 00 00 02 b0 4D
			29 01 00 00 00 00 02 b1 69
			29 01 00 00 00 00 02 b2 07
			29 01 00 00 00 00 02 b3 80
			29 01 00 00 00 00 02 b5 47
			29 01 00 00 00 00 02 b7 8A
			29 01 00 00 00 00 02 b8 21
			29 01 00 00 00 00 02 C1 78
			29 01 00 00 00 00 02 C2 78
			29 01 00 00 00 00 02 D0 88
			29 01 00 00 00 00 04 e0 00 00 02
			29 01 00 00 00 00 0c e1 03 00 00 00 04 00 00 00 00 20 20
			29 01 00 00 00 00 0e e2 00 00 00 00 00 00 00 00 00 00 00 00 00
			29 01 00 00 00 00 05 e3 00 00 33 00
			29 01 00 00 00 00 03 e4 22 00
			29 01 00 00 00 00 11 e5 04 5C A0 A0 06 5C A0 A0 00 00 00 00 00 00 00 00
			29 01 00 00 00 00 05 e6 00 00 33 00
			29 01 00 00 00 00 03 e7 22 00
			29 01 00 00 00 00 11 e8 05 5C A0 A0 07 5C A0 A0 00 00 00 00 00 00 00 00
			29 01 00 00 00 00 08 eb 02 00 40 40 00 00 00
			29 01 00 00 00 00 11 ed fA 45 0B ff ff ff ff ff ff ff ff ff ff B0 54 Af
			29 01 00 00 00 00 06 FF 77 01 00 00 00
			29 01 00 00 96 00 02 11 00                  
			29 01 00 00 50 00 02 29 00];
		qcom,mdss-dsi-off-command = [05 01 00 00 32 00 02 28 00
					05 01 00 00 78 00 02 10 00];
		qcom,mdss-dsi-on-command-state = "dsi_lp_mode";
		qcom,mdss-dsi-off-command-state = "dsi_lp_mode";
		qcom,mdss-dsi-h-sync-pulse = <1>;
		qcom,mdss-dsi-traffic-mode = "burst_mode";
		qcom,mdss-dsi-lane-map = "lane_map_0123";
		qcom,mdss-dsi-bllp-eof-power-mode;
		qcom,mdss-dsi-bllp-power-mode;
		qcom,mdss-dsi-lane-0-state;
		qcom,mdss-dsi-lane-1-state;
		qcom,mdss-dsi-panel-timings = [b8 0c 08 00 2a 2c 10 12 08 03 04 00];
		qcom,mdss-dsi-t-clk-post = <0x1e>;
		qcom,mdss-dsi-t-clk-pre = <0x38>;  
		qcom,mdss-dsi-bl-min-level = <500>;
		qcom,mdss-dsi-bl-max-level = <4095>;
		qcom,mdss-dsi-bl-pmic-control-type = "bl_ctrl_pwm";
		qcom,mdss-dsi-bl-pmic-pwm-frequency = <100>;
		qcom,mdss-dsi-bl-pmic-bank-select = <0>;
		qcom,mdss-dsi-pwm-gpio = <&pm8909_mpps 2 0>;
		qcom,mdss-dsi-dma-trigger = "trigger_sw";
		qcom,mdss-dsi-mdp-trigger = "none"; 
		qcom,mdss-dsi-reset-sequence = <1 20>, <0 20>, <1 120>;
	};
};
